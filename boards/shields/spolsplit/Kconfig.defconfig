## boards/shields/spolsplit/Kconfig.defconfig
```kconfig
if	SPOLSPLIT_LEFT

	config ZMK_KEYBOARD_NAME
		default "SpolSplit"

	config ZMK_SPLIT_ROLE_CENTRAL
		default y

endif

if SPOLSPLIT_LEFT || SPOLSPLIT_RIGHT

	config ZMK_SPLIT
		default y

endif
```

## boards/shields/spolsplit/Kconfig.shield
```kconfig
config SHIELD_SPOLSPLIT_LEFT
	def_bool $(shields_list_contains,spolsplit_left)

config SHIELD_SPOLSPLIT_RIGHT
	def_bool $(shields_list_contains,spolsplit_right)
```
